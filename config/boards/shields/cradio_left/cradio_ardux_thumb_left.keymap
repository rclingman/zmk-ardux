/*
 * Copyright (c) 2020 The ZMK Contributors
 *
 * SPDX-License-Identifier: MIT
 */

#include <behaviors.dtsi>
#include <dt-bindings/zmk/keys.h>
#include <dt-bindings/zmk/bt.h>

// Enable ARDUX Left
#define ARDUX_BIG 1

// ARTS Row
#define KEY_A 3
#define KEY_R 2
#define KEY_T 1
#define KEY_S 0
// EYIO Row
#define KEY_E 8
#define KEY_Y 7
#define KEY_I 6
#define KEY_O 5

// Define Custom Thumb Keys
#define CUSTOM_THUMB &kp LSHFT &kp LSHFT

// Define Offsets
//#define LEADING_NONES NONE(0, 1, 0)
//#define MIDDLE_NONES NONE(0, 0, 3)
//#define TRAILING_NONES NONE(0, 1, 0)

// Include main ardux.io keymap
#include "../../../ardux.dtsi"
