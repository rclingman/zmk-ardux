/*
 * Copyright (c) 2020 The ZMK Contributors
 *
 * SPDX-License-Identifier: MIT
 */

#include <behaviors.dtsi>
#include <dt-bindings/zmk/keys.h>
#include <dt-bindings/zmk/bt.h>

//  Enable ARDUX Left
#define ARDUX_LEFT 1

// ARTS Row
#define KEY_A 5
#define KEY_R 6
#define KEY_T 7
#define KEY_S 8
// EYIO Row
#define KEY_E 13
#define KEY_N 12
#define KEY_I 11
#define KEY_O 10

// Define Custom Thumb Keys
#define CUSTOM_THUMB &kp LEFT_SHIFT &kp LEFT_CONTROL

// Define Offsets
// gives the horizontal offset, but breaks combos
#define LEADING_NONES NONE(0,0,0)
// no difference when changing by one?
#define MIDDLE_NONES NONE(0,0,1)
// this seems to affect the thumb keys
#define TRAILING_NONES NONE(0,0,6)

// Include main ardux.io keymap
#include "../../../ardux.dtsi"
