## config/boards/shields/ferris-sweep-left/Kconfig.shield
```kconfig
# Copyright (c) 2020 The ZMK Contributors
# SPDX-License-Identifier: MIT

config SHIELD_FERRIS_ARDUX_LEFT
	def_bool $(shields_list_contains,ferris_ardux_left)

config SHIELD_CRADIO_ARDUX_THUMB_LEFT
	def_bool $(shields_list_contains,ferris_ardux_thumb_left)
```
